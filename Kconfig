## Kconfig
```kconfig
#
# For a description of the syntax of this configuration file,
# see the file kconfig-language.txt in the NuttX tools repository.
#

config JITEST
	bool "Jitter test"
	default n
	depends on TIMER && BUILD_FLAT
	---help---
		Enable the timer example

if JITEST

config JITEST_APPNAME
	string "Executable name"
	default "jitest"
	depends on NSH_BUILTIN_APPS
	---help---
		This is the name of the built-in application

config JITEST_STACKSIZE
	int "Jitest stack size"
	default 2048
	depends on NSH_BUILTIN_APPS
	---help---
		This is the stack size allocated when the jitest task runs

config JITEST_PRIORITY
	int "Jitest task priority"
	default 100
	depends on NSH_BUILTIN_APPS
	---help---
		This is the priority of the timer task

config JITEST_PROGNAME
	string "Jitest program name"
	default "jitest"
	depends on BUILD_KERNEL
	---help---
		This is the name of the program that will be use when the NSH ELF
		program is installed.

endif
```
